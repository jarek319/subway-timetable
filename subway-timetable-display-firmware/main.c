#include <stdio.h>
#include "stm32f10x.h"
#include "stm32f10x_rcc.h"
#include "stm32f10x_gpio.h"
#include "stm32f10x_tim.h"
//PORTA
#define A_PIN (1UL<<0)
#define B_PIN (1UL<<1)
#define C_PIN (1UL<<2)
#define D_PIN (1UL<<3)

//PORTB
#define OE_PIN (1UL<<5)
#define LAT_PIN (1UL<<6)
#define CLK_PIN (1UL<<7)
#define R1_PIN (1UL<<8)
#define G1_PIN (1UL<<9)
#define B1_PIN (1UL<<10)
#define R2_PIN (1UL<<11)
#define G2_PIN (1UL<<12)
#define B2_PIN (1UL<<13)

uint8_t frame = 0;
const uint16_t bitmap[0x800] ={
0x0000, 0x0000, 0x0000, 0x0000, 0x0000, 0x0000, 0x0000, 0x0000, 0x0000, 0x0000, 0x0000, 0x0000, 0x0000, 0x0000, 0x0000, 0x0000,   // 0x0010 (16)
0x0000, 0x0000, 0x0000, 0x0000, 0x0000, 0x0000, 0x0000, 0x0000, 0x0000, 0x0000, 0x0000, 0x0000, 0x0000, 0x0000, 0x0000, 0x0000,   // 0x0020 (32)
0x0000, 0x0000, 0x0000, 0x0000, 0x0000, 0x0000, 0x0000, 0x0000, 0x0000, 0x0000, 0x0000, 0x0000, 0x0000, 0x0000, 0x0000, 0x0000,   // 0x0030 (48)
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0x0000, 0x0000, 0x0000, 0x0000, 0x0000, 0x0000, 0x0000, 0x0000, 0x0000, 0x0000, 0x0000, 0x0000, 0x0000, 0x0000, 0x0000, 0x0000,   // 0x0800 (2048)
};
const uint16_t bitmap2[0x800] ={
0x0000, 0x0000, 0x0000, 0x0000, 0x0000, 0x0000, 0x0000, 0x0000, 0x0000, 0x0000, 0x0000, 0x0000, 0x0000, 0x0000, 0x0000, 0x0000,   // 0x0010 (16)
0x0000, 0x0000, 0x0000, 0x0000, 0x0000, 0x0000, 0x0000, 0x0000, 0x0000, 0x0000, 0x0000, 0x0000, 0x0000, 0x0000, 0x0000, 0x0000,   // 0x0020 (32)
0x0000, 0x0000, 0x0000, 0x0000, 0x0000, 0x0000, 0x0000, 0x0000, 0x0000, 0x0000, 0x0000, 0x0000, 0x0000, 0x0000, 0x0000, 0x0000,   // 0x0030 (48)
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0x0000, 0x0000, 0x0000, 0x0000, 0x0000, 0x0000, 0x0000, 0x0000, 0x0000, 0x0000, 0x0000, 0x0000, 0x0000, 0x0000, 0x0000, 0x0000,   // 0x0800 (2048)
};

void SystemCoreClockConfigure(void) {
  RCC->CR |= ((uint32_t)RCC_CR_HSION);                     // Enable HSI
  while ((RCC->CR & RCC_CR_HSIRDY) == 0);                  // Wait for HSI Ready
  RCC->CFGR = RCC_CFGR_SW_HSI;                             // HSI is system clock
  while ((RCC->CFGR & RCC_CFGR_SWS) != RCC_CFGR_SWS_HSI);  // Wait for HSI used as system clock
  FLASH->ACR  = FLASH_ACR_PRFTBE;                          // Enable Prefetch Buffer
  FLASH->ACR |= FLASH_ACR_LATENCY;                         // Flash 1 wait state
  RCC->CFGR |= RCC_CFGR_HPRE_DIV1;                         // HCLK = SYSCLK
  RCC->CFGR |= RCC_CFGR_PPRE1_DIV2;                        // APB1 = HCLK/2
  RCC->CFGR |= RCC_CFGR_PPRE2_DIV1;                        // APB2 = HCLK
  RCC->CR &= ~RCC_CR_PLLON;                                // Disable PLL
  RCC->CFGR &= ~(RCC_CFGR_PLLSRC | RCC_CFGR_PLLXTPRE | RCC_CFGR_PLLMULL);
  RCC->CFGR |=  (RCC_CFGR_PLLSRC_HSI_Div2 | RCC_CFGR_PLLMULL16);
  RCC->CR |= RCC_CR_PLLON;                                 // Enable PLL
  while((RCC->CR & RCC_CR_PLLRDY) == 0) __NOP();           // Wait till PLL is ready
  RCC->CFGR &= ~RCC_CFGR_SW;                               // Select PLL as system clock source
  RCC->CFGR |=  RCC_CFGR_SW_PLL;
  while ((RCC->CFGR & RCC_CFGR_SWS) != RCC_CFGR_SWS_PLL);  // Wait till PLL is system clock src
}
void PWM_Init(void);
volatile uint32_t msTicks;                                 // counts 1ms timeTicks
void SysTick_Handler(void) {
  msTicks++;
}
void Delay (uint32_t dlyTicks) {
  uint32_t curTicks;

  curTicks = msTicks;
  while ((msTicks - curTicks) < dlyTicks) { __NOP(); }
}

int main (void) {
	uint32_t page;
	uint32_t row;
	uint32_t col;
	uint16_t color;
  SystemCoreClockConfigure();
  SystemCoreClockUpdate();
	RCC->APB2ENR |= 1<<2;
	RCC->APB2ENR |= 1<<3;
	GPIOA->CRL   = 0x44443333;
	GPIOA->CRH   = 0x44444444;
	GPIOA->BRR = 0xFFFF;
	GPIOB->CRL   = 0x33344444;
	GPIOB->CRH   = 0x44333333;
	GPIOB->BRR = 0x3FE0;
	
	//PWM_Init();
	SysTick_Config(SystemCoreClock / 1000);
  for (;;) {
		for ( page = 0; page < 5; page++ ) {
			for ( row = 0; row < 16; row++ ) {
				for ( col = 0; col < 64; col++ ) {
					if ( frame ) color = bitmap[( row * 64 ) + col ];
					else color = bitmap2[( row * 64 ) + col ];
					if ( color & ( 1 << ( page + 11 ))) GPIOB->BSRR = R1_PIN;
					else GPIOB->BRR = R1_PIN;
					if ( color & ( 1 << ( page + 5 ))) GPIOB->BSRR = G1_PIN;
					else GPIOB->BRR = G1_PIN;
					if ( color & ( 1 << ( page + 0 ))) GPIOB->BSRR = B1_PIN;
					else GPIOB->BRR = B1_PIN;
					color = bitmap[( row * 64 ) + col + 1024 ];
					if ( color & ( 1 << ( page + 11 ))) GPIOB->BSRR = R2_PIN;
					else GPIOB->BRR = R2_PIN;
					if ( color & ( 1 << ( page + 5 ))) GPIOB->BSRR = G2_PIN;
					else GPIOB->BRR = G2_PIN;
					if ( color & ( 1 << ( page + 0 ))) GPIOB->BSRR = B2_PIN;
					else GPIOB->BRR = B2_PIN;
					GPIOB->BSRR = CLK_PIN;
					GPIOB->BRR = CLK_PIN;
				}
				GPIOB->BSRR = OE_PIN;
				GPIOB->BSRR = LAT_PIN;
				GPIOB->BRR = LAT_PIN;
				GPIOA->BRR = 0xF;
				GPIOA->BSRR = row;			
				GPIOB->BRR = OE_PIN;
			}
		}
	}
}
